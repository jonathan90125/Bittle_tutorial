#include <Wire.h>
#include <Adafruit_PWMServoDriver.h>
#include <MPU6050_6Axis_MotionApps20.h>

#define SERVOMIN 180*4  //最小电机占空比计数
#define SERVOMAX 620*4  //最大电机占空比计数

uint8_t devStatus;
Adafruit_PWMServoDriver pwm=Adafruit_PWMServoDriver();
MPU6050 mpu;


//前进步态
  char trF[36][8] = {
  61,  68,  54,  61, -26, -39, -13, -26,
  66,  61,  58,  55, -26, -39, -13, -26,
  70,  54,  61,  49, -26, -37, -12, -25,
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  60,  70,  53,  62, -26, -39, -13, -26,
};
   
//左转步态 
  char trL[29][8]  = {
 62,  69,  54,  57, -28, -40, -13, -18,
  63,  60,  59,  55, -28, -40, -13, -18,
  64,  51,  62,  53, -28, -37, -12, -18,
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  61,  70,  53,  58, -28, -40, -13, -18,
};

//右转步态
  char trR[29][8]  = {
  61,  64,  55,  61, -26, -31, -15, -26,
  67,  62,  56,  54, -26, -31, -15, -26,
  72,  60,  57,  47, -25, -31, -15, -24,
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  60,  65,  54,  62, -26, -31, -15, -26,
 };
 

//校准电机误差
char cal[16]= {0,  0,  0,  0,  0,  0,  0,  0,  3,  4,  -2,  0, 4,  4, 0,  0};

//关节映射表
byte pins[] = {12, 11, 3, 4,
               13, 10, 5, 2,
               14, 9, 6, 1,
               15, 8, 7, 0
              };

//旋转方向
int8_t rotationDirections[] = {1, -1, 1, 1,
                               1, -1, 1, -1,
                               1, -1, -1, 1,
                               -1, 1, 1, -1
                              };
//角度转化为占空比计数时需要的偏移量
int8_t middleShifts[] = {0, 15, 0, 0,
                         -45, -45, -45, -45,
                         45, 45, -45, -45,
                         -75, -75, -75, -75
                        };


 //将角度转化为占空比计数                       
int S2P(int angle,int i){
  float p=0.0; 
  p = SERVOMIN + 880 + float(middleShifts[i] + cal[i]) * 7.04  * rotationDirections[i] + angle * 7.04 * rotationDirections[i];
  return int(p);
}



volatile bool mpuInterrupt = false;     // 表示mpu interrupt 引脚是否被拉高

void dmpDataReady() {
  mpuInterrupt = true;  //表示发生了中断
}


void setup() {
  //配置串口
  Serial.begin(57600);
  //配置电机pwm
  pwm.begin();
  pwm.setPWMFreq(240);

  //初始化陀螺仪
  mpu.initialize();
    do {   
    //获取dmp状态
    devStatus = mpu.dmpInitialize();
    delay(500); 
    //设置陀螺仪offset
    mpu.setZAccelOffset(985);
    mpu.setXGyroOffset(39);
    mpu.setYGyroOffset(13);
    mpu.setZGyroOffset(-6);
  
    if (devStatus == 0) {   
      mpu.setDMPEnabled(true);
      attachInterrupt(0, dmpDataReady, RISING);
    
    } 
    
  } while (devStatus);//如果dmp没有成功打开，则一直尝试
}



 
float GR=131.0;//陀螺仪 比例系数
int16_t ax=0,ay=0,az=0,gx=0,gy=0,gz=0;//用来存储getMotion6函数读取到的数据
float sum=0;//用来累加z轴旋转角偏移量
int t=0;//标志目前机器人是否发生偏移，以及偏移方向
float gzz;




void loop() {
  
     //设置200作为阀值，避免过于频繁的转向
     if(sum>200){
       t=0;
       }
     else if(sum<-200){
       t=1;
       }  
     else{
        t=2;
      }
      

      //控制部分
      if(t==2){//前进
         for(int i=0;i<=35;i++){
    for(int j=0;j<=7;j++){
      //根据步态数据设置每个关节的转角
      pwm.setPWM(pins[8+j],0,S2P(   (int(trF[i][j]))  ,8+j  ));
 
    }
    //每更新完一次所有关节的角度，读取一次陀螺仪数据
   mpu.getMotion6(&ax,&ay,&az,&gx,&gy,&gz);

   gzz=gz/GR;//关于z轴的旋转角，即水平的转向
   if(abs(gzz)>0.1)//小于0.1的值被当作误差忽略掉
   {
      sum+=gzz;//每当方向发生偏移，sum的值都会增加
      Serial.print("sum: ");Serial.println(sum); //显示目前的偏移量
    }
    }
      }

     else if(t==1){//左转
       for(int i=0;i<=28;i++){
    for(int j=0;j<=7;j++){
   
      pwm.setPWM(pins[8+j],0,S2P(   (int(trL[i][j]))  ,8+j  ));
 
    }
    mpu.getMotion6(&ax,&ay,&az,&gx,&gy,&gz);

   gzz=gz/GR;
   if(abs(gzz)>0.1){
      sum+=gzz;
      Serial.print("sum: ");Serial.println(sum); 
    }
    }
      }
    
       else if(t==0){//右转
      for(int i=0;i<=28;i++){
    for(int j=0;j<=7;j++){
 
      pwm.setPWM(pins[8+j],0,S2P(   (int(trR[i][j]))  ,8+j  ));

    }
    mpu.getMotion6(&ax,&ay,&az,&gx,&gy,&gz);

   gzz=gz/GR;
   if(abs(gzz)>0.1){
      sum+=gzz;
      Serial.print("sum: ");Serial.println(sum); 
    }
    }
      }
}
